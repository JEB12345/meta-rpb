## conf/distro/rpb-multilib.conf
```bitbake
require conf/distro/include/rpb.inc
require conf/distro/include/distro-multilib.inc

DISTRO_NAME = "Reference-Platform-Build-X11-multilib"

DISTRO_FEATURES_append = " x11"
DISTRO_FEATURES_remove = "wayland"
```
